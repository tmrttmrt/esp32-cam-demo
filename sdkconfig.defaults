## sdkconfig.defaults
```kconfig
CONFIG_ESPTOOLPY_BAUD_921600B=y
CONFIG_ESPTOOLPY_BAUD=921600
CONFIG_TASK_WDT=
CONFIG_ESP32_WIFI_TASK_PINNED_TO_CORE_0=y

CONFIG_SPIRAM_SUPPORT=y
CONFIG_SPIRAM_BOOT_INIT=y
CONFIG_SPIRAM_USE_MALLOC=y
CONFIG_ESPTOOLPY_BAUD_921600B=y
CONFIG_ESPTOOLPY_BAUD=921600
CONFIG_ESPTOOLPY_FLASHSIZE_4MB=y
CONFIG_ESPTOOLPY_FLASHSIZE="4MB"
CONFIG_ESPTOOLPY_FLASHSIZE_DETECT=y
CONFIG_ESP32_DEFAULT_CPU_FREQ_240=y
CONFIG_ESP32_DEFAULT_CPU_FREQ_MHZ=240


#
# ESP32 Camera Demo Configuration
#
CONFIG_ESP_WIFI_IS_SOFTAP=y
CONFIG_ESP_WIFI_MODE_AP=y
CONFIG_ESP_WIFI_SSID="M5Cam"
CONFIG_ESP_WIFI_PASSWORD=""
CONFIG_MAX_STA_CONN=1
CONFIG_XCLK_FREQ=10000000

#
# Pin Configuration
#
CONFIG_D0=5
CONFIG_D1=18
CONFIG_D2=19
CONFIG_D3=21
CONFIG_D4=36
CONFIG_D5=39
CONFIG_D6=34
CONFIG_D7=35
CONFIG_XCLK=0
CONFIG_PCLK=22
CONFIG_VSYNC=25
CONFIG_HREF=23
CONFIG_SDA=26
CONFIG_SCL=27
CONFIG_RESET=32
```
